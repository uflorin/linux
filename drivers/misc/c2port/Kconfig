## drivers/misc/c2port/Kconfig
```kconfig
#
# C2 port devices
#

menu C2PORT
config C2PORT_CORE
	tristate "Silicon Labs C2 port support"
	default n
	help
	  This option enables support for Silicon Labs C2 port used to
	  program Silicon micro controller chips (and other 8051 compatible).

	  If your board have no such micro controllers you don't need this
	  interface at all.

	  To compile this driver as a module, choose M here: the module will
	  be called c2port_core. Note that you also need a client module
	  usually called c2port-*.

	  If you are not sure, say N here.


config C2PORT_GPIO
	tristate "C2 port support generic GPIO"
	depends on GPIO_SYSFS
	default n
	help
	  This option enables C2 support for the c2port on a generic
	  gpio interface, using 'bit-banging'.

	  To compile this driver as a module, choose M here: the module will
	  be called c2port-gpio.
endmenu
```
